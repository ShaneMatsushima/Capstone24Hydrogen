VERSION "HIPBYYYYYYYYYYYYYYYYYYYYYYYYYYYYNNNNNNNNNN/4/%%%/4/'%**4NNN///"

NS_ :

BS_:

BU_: THMM_10178 THMM_10179 ADMM_04262 CNMM_06645 CSM_GmbH

BO_ 155 GPS_Arduino_2: 8 Vector__XXX
 SG_ Speed : 16|16@1+ (0.01,0) [0|655.35] "mph" Vector__XXX
 SG_ Altitude : 0|16@1+ (0.1,-1000) [0|0] "m" Vector__XXX

BO_ 154 GPS_Arduino_1: 8 Vector__XXX
 SG_ Longitude : 32|32@1+ (1E-007,-150) [-150|279.4967295] "deg" Vector__XXX
 SG_ Latitude : 0|32@1+ (1E-007,-150) [-150|279.4967295] "deg" Vector__XXX

CM_ "CSM = 3, 11, 500000, 66, [198364] DBV(0) CONFIG(7.7.2.2430) IDINCR(1) R(1)";
BA_DEF_  "BusType" STRING ;
BA_DEF_ BU_  "Tables00" STRING ;
BA_DEF_DEF_  "BusType" "";
BA_DEF_DEF_  "Tables00" "";
BA_ "BusType" "CAN";
BA_ "Tables00" BU_ ADMM_04262 "6C5B415A78DAEDC13101000000C2A0F54F6D0A3FA0000000000000781819880001";
